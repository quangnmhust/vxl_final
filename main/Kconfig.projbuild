## main/Kconfig.projbuild
```kconfig
menu "Period Config Menu"

    config PERIOD
        int   "PERIOD"
        default 10000
        help
            Chu ky lay mau cua sensor.

    config HTTP_PERIOD
        int   "PERIOD"
        default 10000
        help
            Chu ky gui data len thingspeak.

    config PROB_WARNING
        int "PROB_WARNING"
        default  5
        help 
            Nguong canh bao chay.
endmenu

menu "WiFi Config Menu"

    config SSID
        string  "SSID"
        default "Tom Bi"
        help
            SSID.

    config PASSWORD
        string  "PASSWORD"
        default  "TBH123456"
        help 
            PASSWORD.

    config MAXIMUM_AP
        int "Maximum access points"
        default  10
        help 
            Maximum access points.

    config MAXIMUM_RETRY
        int "Maximum retry"
        default 25
        help
            Set the Maximum retry to avoid station reconnecting to the AP unlimited when the AP is really inexistent.

    config SHOW_LIST_ACCESS_POINTS_FOUND
        bool "Show list Access Points found."
        default y
        help
            Show list Access Points found.

endmenu

menu "HTTP Config"
    config WEB_SERVER
    string "CONFIG_WEB_SERVER"
    default "api.thingspeak.com"
    help 
        CONFIG_WEB_SERVER.
    
    config WEB_PORT
        string  "CONFIG_WEB_PORT"
        default  "80"
        help 
            CONFIG_WEB_PORT.

    config API_KEY
        string  "API_KEY"
        default  "26U6PMXDCNABFA97"
        help 
            API_KEY.
endmenu
```
